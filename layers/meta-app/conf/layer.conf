## layers/meta-app/conf/layer.conf
```bitbake
BBPATH .= ":${LAYERDIR}"
BBFILES += "${LAYERDIR}/recipes-*/*.bb"
BBFILE_COLLECTIONS += "app"
BBFILE_PATTERN_app = "^${LAYERDIR}/"
LAYERSERIES_CORENAMES = "hello"
LAYERSERIES_COMPAT_app = "hello"
```
